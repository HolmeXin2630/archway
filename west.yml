## west.yml
```yaml
manifest:
  remotes:
    - name: holmexin
      url-base: https://github.com/HolmeXin2630
    - name: taichi-ishitani
      url-base: https://github.com/taichi-ishitani

  projects:
    - name: sv_serde
      remote: holmexin
      revision: master
      path: lib/sv_serde

    - name: tue
      remote: taichi-ishitani
      revision: master
      path: archway/tests/bus_pkg/lib/tue

    - name: tvip-apb
      remote: taichi-ishitani
      revision: master
      path: archway/tests/bus_pkg/lib/tvip-apb

  self:
    path: archway
```
